## config/west.yml
```yaml
manifest:
  remotes:
    - name: zmkfirmware
      url-base: https://github.com/zmkfirmware
  projects:
    - name: zmk
      remote: zmkfirmware
      revision: ff09f2d0c9f13a868c8f71d71d9348ade438e4b6 # main del 2026-06-07, la versión que compiló el último firmware bueno; actualizar a propósito, no por accidente
      import: app/west.yml
  self:
    path: config
```
